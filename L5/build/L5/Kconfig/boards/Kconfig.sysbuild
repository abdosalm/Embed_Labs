## L5/build/L5/Kconfig/boards/Kconfig.sysbuild
```kconfig
# Load Sysbuild board Kconfig descriptions.
osource "/home/ams/ncs/boards/auc_embed_boards/boards/AUC/auc_embedkit/Kconfig.sysbuild"
```

## L7/build/Kconfig/Kconfig.shield.defconfig
```kconfig
osource "/home/ams/ncs/boards/auc_embed_boards/boards/shields/*/Kconfig.defconfig"
osource "/home/ams/ncs/v2.9.0/nrf/boards/shields/*/Kconfig.defconfig"
```

## L7/build/L7/Kconfig/Kconfig.shield
```kconfig
osource "/home/ams/ncs/boards/auc_embed_boards/boards/shields/*/Kconfig.shield"
osource "/home/ams/ncs/v2.9.0/nrf/boards/shields/*/Kconfig.shield"
```

## L8/build/Kconfig/boards/Kconfig.defconfig
```kconfig
# Load Zephyr board defconfig descriptions.
osource "/home/ams/ncs/boards/auc_embed_boards/boards/AUC/auc_embedkit/Kconfig.defconfig"
```
