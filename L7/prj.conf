## CMakeLists.txt
```
cmake_minimum_required(VERSION 3.20.0)
find_package(Zephyr REQUIRED HINTS $ENV{ZEPHYR_BASE})

project(L7)

target_sources(app PRIVATE src/main.c)
```

## prj.conf
```kconfig
# enable including of the console drivers 
CONFIG_CONSOLE=y

# Enable Segger J-Link RTT libraries for platforms that support it. 
# Selection of this option enables use of RTT for various subsystems. Note that by enabling this option, 
# RTT buffers consume more RAM.
CONFIG_USE_SEGGER_RTT=y

# Emit console messages to a RAM buffer that is then read by the Segger J-Link software and displayed on a computer in real-time. 
# Requires support for Segger J-Link on the companion IC onboard.
CONFIG_RTT_CONSOLE=y

# The threads we will create here will have the same priority (4), and they will have time slicing enabled for a period of 10 ms. 
# This means each thread will be given 10 ms to finish its task before it’s forcefully preempted by the scheduler to allow the other equal priority threads to run.
CONFIG_TIMESLICING=y
CONFIG_TIMESLICE_SIZE=10
CONFIG_TIMESLICE_PRIORITY=4

# allowing the use of random number generator included in the zephyr library
CONFIG_ENTROPY_GENERATOR=y
CONFIG_TEST_RANDOM_GENERATOR=y
```

## src/main.c
```c
/**
 * Exercise1: Threads Intro
 */


// #include <zephyr/kernel.h>


// void Thread1(void)
// {
//     while(1)
//     {
//         printk("Thread0\n\r");
//         // k_yield();
//         // k_msleep(5);
//     }
// }

// void Thread2(void)
// {
//     while(1)
//     {
//         printk("Thread1\n\r");
//         // k_yield();
//         // k_msleep(5);
//     }
// }

// /**
//      * Parameters:
//         name	Name of the thread.
//         stack_size	Stack size in bytes.
//         entry	Thread entry function.
//         p1	1st entry point parameter.
//         p2	2nd entry point parameter.
//         p3	3rd entry point parameter.
//         prio	Thread priority.
//         options	Thread options.
//         delay	Scheduling delay (in milliseconds), zero for no delay.
//     */
       
// K_THREAD_DEFINE(thread0_ID, 1024, Thread1, NULL, NULL, NULL, 7, 0, 0);
// K_THREAD_DEFINE(thread1_ID, 1024, Thread2, NULL, NULL, NULL, 7, 0, 0);

// int main(void)
// {
//     return 0;
// }


/**
 * Exercise2: Mutex
 */


#include <zephyr/kernel.h>
#include <zephyr/random/random.h>

#define COMBINED_TOTAL   40
int32_t increment_count = 0; 
int32_t decrement_count = COMBINED_TOTAL;

K_MUTEX_DEFINE(mutex);

void critical_section()
{
     k_mutex_lock(&mutex, K_FOREVER);
    increment_count++;
    decrement_count--;
    increment_count = increment_count % COMBINED_TOTAL; 
    if (decrement_count == 0) 
    {
        decrement_count = COMBINED_TOTAL;
    }
     k_mutex_unlock(&mutex);

    // at any time, the inc_count + dec_count  = 40
    if(increment_count + decrement_count != COMBINED_TOTAL )
	{
		printk("Race condition happend! current Thread = %s\n\r", k_thread_name_get(k_current_get()));
		printk("Increment_count (%d) + Decrement_count (%d) = %d \n\r",
	                increment_count, decrement_count, (increment_count + decrement_count));

        // sleep a radnom time from 400ms to 409ms 
		k_msleep(400 + sys_rand32_get() % 10);
	}

}

void Thread1(void)
{
    printk("Thread 1 started\n\r");
    while(1)
    {
        critical_section();
    }
}

void Thread2(void)
{   
    printk("Thread 2 started\n\r");
    while(1)
    {
        critical_section();
    }
}
       
K_THREAD_DEFINE(thread1_ID, 1024, Thread1, NULL, NULL, NULL, 7, 0, 0);
K_THREAD_DEFINE(thread2_ID, 1024, Thread2, NULL, NULL, NULL, 7, 0, 0);

int main(void)
{
    printk("main started\n\r");
    return 0;
}
```
